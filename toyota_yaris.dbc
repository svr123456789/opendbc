VERSION ""

NS_ :

BS_:

BU_: XXX

BO_ 1568 untited: 8 XXX

BO_ 608 rotation_volant: 8 XXX
 SG_ rotation_volant : 47|24@0- (1,0) [0|16777215] "" XXX

BO_ 705 accelerateur: 8 XXX
 SG_ NEW_SIGNAL_1 : 15|32@0+ (1,0) [0|4294967295] "" XXX
 SG_ accelerateur : 55|16@0+ (1,0) [0|255] "" XXX

BO_ 708 RPM: 8 XXX
 SG_ NEW_SIGNAL_1 : 55|16@0+ (1,0) [0|65535] "" XXX
 SG_ RPM : 7|16@0+ (1,0) [0|65535] "" XXX

BO_ 178 NEW_MSG_1: 8 XXX
 SG_ NEW_SIGNAL_1 : 7|48@0+ (1,0) [0|281474976710655] "" XXX

BO_ 176 NEW_MSG_2: 8 XXX
 SG_ NEW_SIGNAL_1 : 7|48@0+ (1,0) [0|281474976710655] "" XXX

BO_ 180 NEW_MSG_3: 8 XXX
 SG_ NEW_SIGNAL_1 : 39|32@0+ (1,0) [0|4294967295] "" XXX

BO_ 947 NEW_MSG_4: 8 XXX
 SG_ NEW_SIGNAL_1 : 7|24@0+ (1,0) [0|16777215] "" XXX

BO_ 920 NEW_MSG_5: 8 XXX
 SG_ NEW_SIGNAL_1 : 7|16@0+ (1,0) [0|65535] "" XXX

BO_ 1552 NEW_MSG_6: 8 XXX
 SG_ NEW_SIGNAL_1 : 23|24@0+ (1,0) [0|16777215] "" XXX
